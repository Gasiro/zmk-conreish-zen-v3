## boards/arm/corneish_zen/Kconfig
```kconfig
#
# Copyright (c) 2022 The ZMK Contributors
# SPDX-License-Identifier: MIT
#

config BOARD_CORNEISH_ZEN_LEFT
    bool

config BOARD_CORNEISH_ZEN_RIGHT
    bool

config ZMK_STUDIO_SUPPORT
    bool "Enable ZMK Studio Support"
    default y
    help
      This option enables support for ZMK Studio features
```

## config/west.yml
```yaml
manifest:
  remotes:
    - name: zmkfirmware
      url-base: https://github.com/zmkfirmware
    # Additional modules containing boards/shields/custom code can be listed here as well
    # See https://docs.zephyrproject.org/3.2.0/develop/west/manifest.html#projects
    - name: prospector  # <<== prospector support
      url-base: https://github.com/t-ogura  # <<== prospector support
  projects:
    - name: zmk
      remote: zmkfirmware
      revision: main
      import: app/west.yml
    - name: prospector-zmk-module  # <<== prospector support
      remote: prospector  # <<== prospector support
      revision: v1.1.1  # <<== prospector support
      path: modules/prospector-zmk-module  # <<== prospector support
  self:
    path: config
```
